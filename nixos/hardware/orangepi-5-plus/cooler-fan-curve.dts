/dts-v1/;
/plugin/;

/ {
	compatible = "xunlong,orangepi-5-plus";

	/*
	 * The Armbian/Rockchip vendor DTB drives pwm-fan with its custom
	 * rockchip,temp-trips property, rather than the mainline package_thermal
	 * cooling maps.  Target the vendor node by its stable absolute path.
	 */
	fragment@0 {
		target-path = "/pwm-fan";
		__overlay__ {
			cooling-levels = <0 90 140 200 255>;
			rockchip,temp-trips = <
				42000 1
				48000 2
				55000 3
				62000 4
				68000 5
			>;
		};
	};
};
